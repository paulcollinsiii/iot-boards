## esp-idf-humidity/components/alarm/Kconfig
```kconfig
menu "Alarm"

config ALARM_NUM_MAX
  int "Maximum number of configurable alarms"
  default 3
  range 1 10

endmenu
```

## esp-idf-humidity/components/blinky/Kconfig
```kconfig
menu "blinky lights"

config BLINKY_MAX_BRIGHTNESS
  depends on IDF_TARGET_ESP32S2
  int "Max brightness for NeoPixel"
  default 31
  range 1 31

endmenu
```

## esp-idf-humidity/components/ltr390/Kconfig
```kconfig
menu "ltr390"

config LTR390_ENABLED
  bool "Enable LTR390"
  default n

config LTR390_GPIO_SDA
  depends on LTR390_ENABLED
  int "GPIO for SDA"
  default 23
  range 1 43

config LTR390_GPIO_SCL
  depends on LTR390_ENABLED
  int "GPIO for SCL"
  default 22
  range 1 43

config LTR390_I2C_PORTNUM
  depends on LTR390_ENABLED
  int "I2C Port Number"
  default 0
  range 0 1

endmenu
```

## esp-idf-humidity/components/mqttmgr/Kconfig
```kconfig
menu "mqttlog"

config MQTTLOG_RINGBUF_SIZE
  int "Ringbuffer size (in K) for log messages"
  default 2
  range 1 4096

endmenu
```

## esp-idf-humidity/components/otamgr/Kconfig
```kconfig
menu "OTA Support"

config OTAMGR_ENABLED
  bool "Enable OTA Manager"
  default n

config OTAMGR_FIRMWARE_URL_BASE
  string "Base URL for firmware"
  default "https://ota.iot.kaffi.home:443/firmware/"

endmenu
```

## esp-idf-humidity/components/sensormgr/Kconfig
```kconfig
menu "sensormgr"

config SENSORMGR_RINGBUF_SIZE
  int "Ringbuffer size (in K) for measurements"
  default 32
  range 8 4096

config SENSORMGR_SAMPLE_RATE
  int "Delay (ms) between polling of all sensors"
  default 2000
  range 2000 60000

endmenu
```

## esp-idf-humidity/components/sht4x/Kconfig
```kconfig
menu "SHT4X"

config SHT4X_ENABLED
  bool "Enable SHT4X"
  default n

config SHT4X_GPIO_SDA
  depends on SHT4X_ENABLED
  int "GPIO for SDA"
  default 23
  range 1 43

config SHT4X_GPIO_SCL
  depends on SHT4X_ENABLED
  int "GPIO for SCL"
  default 22
  range 1 43

config SHT4X_I2C_PORTNUM
  depends on SHT4X_ENABLED
  int "I2C Port Number"
  default 0
  range 0 1

endmenu
```

## esp-idf-humidity/components/shtc3/Kconfig
```kconfig
menu "SHTC3"

config SHTC3_ENABLED
  bool "Enable SHTC3"
  default n

config SHTC3_GPIO_SDA
  depends on SHTC3_ENABLED
  int "GPIO for SDA"
  default 23
  range 1 43

config SHTC3_GPIO_SCL
  depends on SHTC3_ENABLED
  int "GPIO for SCL"
  default 22
  range 1 43

config SHTC3_I2C_PORTNUM
  depends on SHTC3_ENABLED
  int "I2C Port Number"
  default 0
  range 0 1

endmenu
```

## esp-idf-humidity/components/touchbtn/Kconfig
```kconfig
menu "touch buttons"

config TOUCHBTN_ENABLED
  bool "Enable Touch buttons"
  default n

config TOUCHBTN_WIFI_PAD
  depends on TOUCHBTN_ENABLED
  depends on IDF_TARGET_ESP32
  int "Touchpad id for wifi button"
  default 9
  range 0 10

config TOUCHBTN_SLEEP_PAD
  depends on TOUCHBTN_ENABLED
  depends on IDF_TARGET_ESP32
  int "Touchpad id for sleep button"
  default 8
  range 0 10

endmenu
```

## esp-idf-humidity/sdkconfig.defaults
```kconfig
CONFIG_NEWLIB_NANO_FORMAT=y
CONFIG_LTR390_ENABLED=y
CONFIG_SENSORMGR_RINGBUF_SIZE=12
CONFIG_SENSORMGR_SAMPLE_RATE=5000
```
